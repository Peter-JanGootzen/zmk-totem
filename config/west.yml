## config/west.yml
```yaml
manifest:
  remotes:
    - name: zmkfirmware
      url-base: https://github.com/zmkfirmware
    - name: carrefinho
      url-base: https://github.com/carrefinho
  projects:
    - name: zmk
      remote: zmkfirmware
      revision: v0.3.0
      import: app/west.yml
    - name: prospector-zmk-module
      remote: carrefinho
      revision: b519f9fc1747df5c7f4ff705b05d6c00d27b80a1
  self:
    path: config
```
